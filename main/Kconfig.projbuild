## main/Kconfig.projbuild
```kconfig
menu "Pet Project Configuration"

    config PET_WIFI_SSID
        string "WiFi SSID"
        default ""
        help
            SSID of the Wi-Fi network the pet will connect to.

    config PET_WIFI_PASSWORD
        string "WiFi Password"
        default ""
        help
            Password of the Wi-Fi network.

    config PET_WIFI_MAX_RETRY
        int "WiFi max retry count"
        default 5
        range 0 30
        help
            Maximum connection retries before giving up.

    config PET_AI_USAGE_KIMI_KEY
        string "Kimi API key (api.kimi.com)"
        default ""
        help
            Bearer token for Kimi usage API. Empty hides the AI Usage tab.

    config PET_AI_USAGE_MINIMAX_KEY
        string "MiniMax API key (www.minimaxi.com)"
        default ""
        help
            Bearer token for MiniMax usage API. Empty hides just the MiniMax card.

endmenu
```

## sdkconfig.defaults
```kconfig
CONFIG_IDF_TARGET="esp32s3"
CONFIG_ESPTOOLPY_FLASHSIZE_16MB=y
CONFIG_SPIRAM=y
CONFIG_SPIRAM_MODE_OCT=y
CONFIG_SPIRAM_SPEED_80M=y
CONFIG_ESP_DEFAULT_CPU_FREQ_MHZ_240=y
CONFIG_ESP32S3_INSTRUCTION_CACHE_32KB=y
CONFIG_ESP32S3_DATA_CACHE_64KB=y
CONFIG_ESP32S3_DATA_CACHE_LINE_64B=y

# Partition table: use the custom 16 MB layout in partitions.csv
CONFIG_PARTITION_TABLE_CUSTOM=y
CONFIG_PARTITION_TABLE_CUSTOM_FILENAME="partitions.csv"

# Compiler: optimize for size to fit BLE+WiFi+LVGL into the factory partition
CONFIG_COMPILER_OPTIMIZATION_SIZE=y

# Bluetooth (NimBLE peripheral)
CONFIG_BT_ENABLED=y
CONFIG_BT_BLUEDROID_ENABLED=n
CONFIG_BT_NIMBLE_ENABLED=y

# LVGL 9 configuration
CONFIG_LV_COLOR_DEPTH_16=y
CONFIG_LV_FONT_MONTSERRAT_12=y
CONFIG_LV_FONT_MONTSERRAT_14=y
CONFIG_LV_FONT_MONTSERRAT_16=y
CONFIG_LV_FONT_MONTSERRAT_20=y
CONFIG_LV_FONT_MONTSERRAT_48=y
CONFIG_LV_USE_LABEL=y
CONFIG_LV_USE_BAR=y
CONFIG_LV_USE_BUTTON=y
CONFIG_LV_USE_IMAGE=y
CONFIG_LV_USE_ARC=y
CONFIG_LV_USE_ANIM=y

# Required so LV_COLOR_FORMAT_RGB565A8 sprites composite correctly on a
# 16 bpp display (replaces the old 8.x LV_DRAW_SW_SUPPORT_RGB565_SWAPPED).
CONFIG_LV_DRAW_SW_SUPPORT_RGB565A8=y

# ST77xx panels expect little-endian per-pixel RGB565; keep this off.
CONFIG_LV_COLOR_16_SWAP=n

# Wi-Fi credentials intentionally left empty.
# Fill via `idf.py menuconfig` -> "Pet project defaults" -> Wi-Fi SSID / Password
# (or set the CONFIG_PET_WIFI_* env vars before invoking idf.py).
CONFIG_PET_WIFI_SSID=""
CONFIG_PET_WIFI_PASSWORD=""
CONFIG_PET_WIFI_MAX_RETRY=5
CONFIG_I2C_SKIP_LEGACY_CONFLICT_CHECK=y
```
